## conf/distro/asymptotic.conf
```bitbake
include conf/distro/poky.conf

DISTRO_FEATURES:append = " systemd pam virtualization pipewire pipewire-tools pipewire-spa-tools pipewire-alsa alsa alsa-utils sndfile"
DISTRO_FEATURES:remove = "3g sysvinit x11"
DISTRO_FEATURES_BACKFILL_CONSIDERED += "sysvinit"

VIRTUAL-RUNTIME_init_manager = "systemd"
VIRTUAL-RUNTIME_initscripts = "systemd-compat-units"

LICENSE_FLAGS_ACCEPTED += "commercial Proprietary commercial_gstreamer1.0-libav commercial_ffmpeg commercial_x264 non-commercial"

PACKAGECONFIG:append:pn-pipewire = " alsa pipewire-alsa gstreamer pw-cat sndfile systemd systemd-system-service udev"
PACKAGECONFIG:append:pn-systemd = " resolved networkd"
PACKAGECONFIG:append:pn-dbus = " systemd user-session"

INHERIT += "buildhistory"
INHERIT += "image-buildinfo"
BUILDHISTORY_COMMIT = "1"
```

## conf/layer.conf
```bitbake
# We have a conf and classes directory, add to BBPATH
BBPATH .= ":${LAYERDIR}"

# We have recipes-* directories, add to BBFILES
BBFILES += "${LAYERDIR}/recipes-*/*/*.bb \
            ${LAYERDIR}/recipes-*/*/*.bbappend"

BBFILE_COLLECTIONS += "meta-asymptotic"
BBFILE_PATTERN_meta-asymptotic = "^${LAYERDIR}/"
BBFILE_PRIORITY_meta-asymptotic = "6"

LAYERDEPENDS_meta-asymptotic = "core"
LAYERSERIES_COMPAT_meta-asymptotic = "mickledore langdale kirkstone"

LAYERDEPENDS_meta-asymptotic = "openembedded-layer meta-python networking-layer \
                         filesystems-layer multimedia-layer virtualization-layer \
                        meta-96boards meta-rpb"
```
